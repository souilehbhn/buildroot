## package/g2o/Config.in
```kconfig
config BR2_PACKAGE_G2O
	bool "g2o"
  depends on BR2_PACKAGE_EIGEN
  help
    g2o is an open-source C++ framework for optimizing graph-based
    nonlinear error functions.
    https://github.com/RainerKuemmerle/g2o

comment "g2o depends on eigen"
	depends on !BR2_PACKAGE_EIGEN
```

## package/lsdslam/Config.in
```kconfig
config BR2_PACKAGE_LSDSLAM
	bool "lsd_slam"
	depends on BR2_PACKAGE_EIGEN
	depends on BR2_PACKAGE_PANGOLIN
	depends on BR2_PACKAGE_G2O
	depends on BR2_PACKAGE_OPENCV3
	depends on BR2_PACKAGE_BOOST
	depends on BR2_PACKAGE_SUITESPARSE_CHOLMOD
	depends on BR2_PACKAGE_SUITESPARSE_CXSPARSE
	select BR2_PACKAGE_BOOST_THREAD
	select BR2_PACKAGE_BOOST_FILESYSTEM
	select BR2_PACKAGE_BOOST_SYSTEM
	select BR2_PACKAGE_OPENCV3_LIB_IMGPROC
	select BR2_PACKAGE_OPENCV3_LIB_CALIB3D
	select BR2_PACKAGE_OPENCV3_LIB_HIGHGUI
	help
	  LSD-SLAM Large-Scale Direct Monocular SLAM
	  https://github.com/tum_vision/lsd_slam

comment "LSD_SLAM depends on OpenCV, Eigen, Boost, g2o and pangolin"
	depends on !BR2_PACKAGE_EIGEN || !BR2_PACKAGE_PANGOLIN || !BR2_PACKAGE_G2O || !BR2_PACKAGE_OPENCV3 || !BR2_PACKAGE_BOOST || !BR2_PACKAGE_SUITESPARSE_CHOLMOD || !BR2_PACKAGE_SUITESPARSE_CXSPARSE
```

## package/orb-slam2/Config.in
```kconfig
config BR2_PACKAGE_ORB_SLAM2
	bool "ORB-SLAM 2"
  depends on BR2_PACKAGE_HAS_LIBGL
  depends on BR2_PACKAGE_LIBGLEW
  depends on BR2_INSTALL_LIBSTDCPP
  depends on BR2_PACKAGE_OPENCV3
  select BR2_PACKAGE_PANGOLIN
  select BR2_PACKAGE_EIGEN

  help
    ORB-SLAM, SLAM algorithm
    https://github.com/raulmur/ORB_SLAM2

comment "ORB-SLAM 2 requires OpenCV3 and Pangolin"
	depends on !BR2_PACKAGE_LIBGLEW || !BR2_PACKAGE_HAS_LIBGL || !BR2_PACKAGE_OPENCV3
```

## package/pangolin/Config.in
```kconfig
config BR2_PACKAGE_PANGOLIN
	bool "Pangolin"
  depends on BR2_PACKAGE_HAS_LIBGL
  depends on BR2_PACKAGE_LIBGLEW
  depends on BR2_INSTALL_LIBSTDCPP
	select BR2_PACKAGE_LIBGLU
  help
    Pangolin, is a lightweight library to manipulate OpenGL display
    needed by some graphical software.
    https://github.com/stevenlovegroove/Pangolin

comment "Pangolin depends on libglu and needs an OpenGL backend"
	depends on !BR2_PACKAGE_LIBGLEW || !BR2_PACKAGE_HAS_LIBGL
```

## package/suitesparse/Config.in
```kconfig
comment "Suitesparse needs CLAPACK"
	depends on !BR2_PACKAGE_CLAPACK

menuconfig BR2_PACKAGE_SUITESPARSE
	bool "suitesparse"
	depends on BR2_PACKAGE_CLAPACK
	help
	  A Suite of Sparse matrix package at 
	  http://www.suitesparse.com


if BR2_PACKAGE_SUITESPARSE

comment "SuiteSparse modules"
comment "Not all modules are offered"

config BR2_PACKAGE_SUITESPARSE_METIS
	bool "metis"
	help
	  METIS 5.1.0 with minor modificatiosn to incorporate it 
	  into SuiteSparse.

config BR2_PACKAGE_SUITESPARSE_AMD
	bool "AMD"
	help
	  A set of routines for permuting sparse matrices prior to 
	  factorization.

config BR2_PACKAGE_SUITESPARSE_CAMD
	bool "CAMD"
	help
	  A set of routines for permuting sparse matrices prior to 
	  factorization.

config BR2_PACKAGE_SUITESPARSE_CCOLAMD
	bool "CCOLAMD"
	help
	  Constarined column approximate minimum degree ordering
	  algorithm.

config BR2_PACKAGE_SUITESPARSE_COLAMD
	bool "COLAMD"
	help
	  Column approximate minimum degree ordering algorithm.

config BR2_PACKAGE_SUITESPARSE_CHOLMOD
	bool "CHOLMOD"
	depends on BR2_PACKAGE_CLAPACK
	select BR2_PACKAGE_SUITESPARSE_METIS
	select BR2_PACKAGE_SUITESPARSE_AMD
	select BR2_PACKAGE_SUITESPARSE_CAMD
	select BR2_PACKAGE_SUITESPARSE_CCOLAMD
	select BR2_PACKAGE_SUITESPARSE_COLAMD
	help
	  A sparse Cholesky modification package
	  CHOLMOD is a set of rourines for factorizing sparse 
	  symmetric positive definite matrices.

config BR2_PACKAGE_SUITESPARSE_CXSPARSE
	bool "cxsparse"
	help
	  CXSparse is a Concise Sparse Matrix package that oerates 
	  on both real and complex matrices.
	  CXSparse is backward compatible with CSparse.


endif
```
